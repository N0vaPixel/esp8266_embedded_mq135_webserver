/*
  @file     MQ135_embedded_server.ino
  @author   A.Hernandez (N0vaPixel)
  @license  GNU GPLv3

  TODO : Serveur async + reconnexion automatique

  Version : 0.1.0
*/

#include "MQ135.h"
#include <ESP8266WiFi.h>
#include <ESP8266WebServer.h>

const int mq135Pin = A0;    // Pin de la sortie analog du MQ135
char ssid[] = "";
char pass[] = "";
bool debug = false;         // Verbosité des messages en série

// Mise en mémoire de la page HTML
const static char HTML[702] PROGMEM = {0x3c,0x21,0x44,0x4f,0x43,0x54,0x59,0x50,0x45,0x20,0x68,0x74,0x6d,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0x6c,0x3e};

int loopTick = 50;
int sensorRefreshTick = 1000;
unsigned long sensorRefreshTime = 0;

float ppm = 0;
int sensorValue = 0;

ESP8266WebServer server(80); // Init d'un objet ESP8266WebServer, écoute sur le port 80

String loadSensorData() {
  if (ppm <= 0) return "unknwon";
  return String(ppm);
}

void sendHTML() {
  if(debug){
    Serial.println("Request index HTML");
  }
  server.send ( 200, "text/html", HTML);
}

void sendSensorData() {
  if(debug){
    Serial.println("Request sensorData");
  }
  server.send ( 200, "text/html", loadSensorData());
}

MQ135 gasSensor = MQ135(mq135Pin);  // Init l'objet MQ135 sur le pin du capteur

void setup()
{
  Serial.begin(74880);     // port série à 74880 bps
  Serial.println("\nPrêt");
  Serial.print("Connexion à ");
  Serial.print(ssid);

  WiFi.begin(ssid, pass);
  int conTimer = millis();
  while (WiFi.status() != WL_CONNECTED) {
    delay(500);
    Serial.print(".");
  }
  Serial.print("Connecté en approx ");
  Serial.print(millis() - conTimer);
  Serial.println(" ms");
  Serial.print("IP locale: ");
  Serial.println(WiFi.localIP());
  Serial.print("MAC: ");
  Serial.println(WiFi.macAddress());
  if (debug) {
    Serial.print("Sous-réseau: ");
    Serial.println(WiFi.subnetMask());
    Serial.print("Gateway: ");
    Serial.println(WiFi.gatewayIP());
    Serial.print("Cannal: ");
    Serial.println(WiFi.channel());
    Serial.print("Status: ");
    Serial.println(WiFi.status());
  }

  server.on("/", sendHTML);
  server.on("/getSensorData", sendSensorData);
  server.begin();

  float rzero = gasSensor.getRZero();
  Serial.print("\nR0: ");
  Serial.println(rzero);
}

void loop()
{
  server.handleClient();
  if (millis() - sensorRefreshTime >= sensorRefreshTick) {  // Actualisation du capteur
    ppm = gasSensor.getPPM();
    sensorValue = analogRead(mq135Pin);
    if (debug) {
      Serial.print("A0: ");
      Serial.print(sensorValue);
      Serial.print("  A0 (Volt): ");
      Serial.print(sensorValue * (5.0 / 1024.0));
      Serial.print("  ppm CO2: ");
      Serial.println(ppm);
    }
    sensorRefreshTime = millis();
  }
  delay(loopTick);
}
